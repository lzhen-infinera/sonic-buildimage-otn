## platform/infinera/sonic_fit.its
```
/dts-v1/;

/ {
    description = "U-Boot fitImage for SONIC Infinera";
    #address-cells = <1>;

    images {
        kernel_frcug3x {
            description = "Linux Kernel for frcug3x";
            data = /incbin/("/boot/vmlinuz-6.1.0-22-2-arm64");
            type = "kernel";
            arch = "arm64";
            os = "linux";
            compression = "none";
            load = <0x80080000>;
            entry = <0x80080000>;
            hash@1 {
                algo = "crc32";
            };
        };
        fdt_frcug3x {
            description = "Flattened Device Tree blob for frcug3x";
            data = /incbin/("/usr/lib/linux-image-6.1.0-22-2-arm64/freescale/infn-ls1046a-tfa.dtb");
            type = "flat_dt";
            arch = "arm64";
            compression = "none";
            load = <0x90000000>;
            hash@1 {
                algo = "crc32";
            };
        };
        ramdisk_frcug3x {
            description = "ramdisk for frcug3x";
            data = /incbin/("/boot/initrd.img-6.1.0-22-2-arm64");
            type = "ramdisk";
            arch = "arm64";
            os = "linux";
            compression = "gzip";
            load = <0x0>;
            entry = <0x0>;
            hash@1 {
                algo = "crc32";
            };
        };
    };
    configurations {
        default = "infn-frcug3x";
        infn-frcug3x {
            description = "Boot Linux kernel with FDT blob + ramdisk for infn-frcug3x";
            kernel = "kernel_frcug3x";
            fdt = "fdt_frcug3x";
            ramdisk = "ramdisk_frcug3x";
            hash@1 {
                algo = "crc32";
            };
        };
   };
};
```
